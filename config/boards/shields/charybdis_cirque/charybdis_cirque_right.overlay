#include "charybdis_cirque.dtsi"

&default_transform {
    col-offset = <7>;
};

&kscan0 {
    diode-direction = "col2row";
    col-gpios
        = <&pro_micro 3 (GPIO_ACTIVE_HIGH)> // COL0
        , <&pro_micro 4 (GPIO_ACTIVE_HIGH)> // COL1
        , <&pro_micro 5 (GPIO_ACTIVE_HIGH)> // COL2
        , <&pro_micro 6 (GPIO_ACTIVE_HIGH)> // COL3
        , <&pro_micro 7 (GPIO_ACTIVE_HIGH)> // COL4
        , <&pro_micro 8 (GPIO_ACTIVE_HIGH)> // COL5
        , <&pro_micro 9 (GPIO_ACTIVE_HIGH)> // COL6
    ;
};
