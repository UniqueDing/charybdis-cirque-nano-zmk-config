## config/boards/shields/charybdis_cirque/Kconfig.defconfig
```kconfig
if SHIELD_CHARYBDIS_CIRQUE_RIGHT

    config ZMK_KEYBOARD_NAME
        default "UniqueDing-KB"

    config ZMK_SPLIT_BLE_ROLE_CENTRAL
        default y

endif

if SHIELD_CHARYBDIS_CIRQUE_LEFT

    config ZMK_KEYBOARD_NAME
        default "UniqueDing-KB-slave"

endif

if SHIELD_CHARYBDIS_CIRQUE_LEFT || SHIELD_CHARYBDIS_CIRQUE_RIGHT

    config ZMK_SPLIT
        default y
    config ZMK_USB
        default y

endif
```

## config/west.yml
```yaml
manifest:
  remotes:
    - name: zmkfirmware
      url-base: https://github.com/Alpotato
  projects:
    - name: zmk
      remote: zmkfirmware
      revision: ptdevice-alpotato
      import: app/west.yml
  self:
    path: config
```
