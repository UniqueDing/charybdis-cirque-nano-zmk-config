#include "charybdis.dtsi"

&default_transform { // The matrix transform for this board is 5 columns over because the left half is 5 columns wide according to the matrix.
    col-offset = <6>;
};

&kscan0 {
        col-gpios
            = <&pro_micro 4 GPIO_ACTIVE_HIGH>
            , <&pro_micro 5 GPIO_ACTIVE_HIGH>
            , <&pro_micro 6 GPIO_ACTIVE_HIGH>
            , <&pro_micro 7 GPIO_ACTIVE_HIGH>
            , <&pro_micro 8 GPIO_ACTIVE_HIGH>
            , <&pro_micro 9 GPIO_ACTIVE_HIGH>
            ;
};

&nice_nano_spi {
    compatible = "nordic,nrf-spim";
    status = "okay";

    miso-pin = <17>; // P0.17
    mosi-pin = <20>; // P0.20
    sck-pin = <31>; // P0.31
    cs-gpios = <&gpio0 29 GPIO_ACTIVE_LOW>; // P0.29

    trackball: trackball@0 {
        status = "okay";
        compatible = "pixart,pmw3360";
        reg = <0>;
        label = "Pixart PMW3360";
        irq-gpios = <&gpio0 8 (GPIO_ACTIVE_LOW | GPIO_PULL_UP)>;
        spi-max-frequency = <2000000>;
        scroll-layer = <5>;
    };
};
